## src/modules/aviant/ats_adc_mock/Kconfig
```kconfig
menuconfig MODULES_AVIANT_ATS_ADC_MOCK
	bool "Aviant ATS ADC Mock"
	default n
	help
		Enable Aviant ATS ADC mock module for SITL testing
```

## src/modules/aviant/ats_voltage_measurement/Kconfig
```kconfig
menuconfig MODULES_AVIANT_ATS_VOLTAGE_MEASUREMENT
	bool "Aviant ATS Voltage Measurement"
	default n
	help
		Enable Aviant ATS voltage measurement module
```
